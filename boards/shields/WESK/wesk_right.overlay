#include "wesk.dtsi"

&default_transform {
    col-offset = <6>; // Dit à ZMK que la première colonne de droite est la colonne index 6
};

&kscan0 {
    compatible = "zmk,kscan-gpio-matrix";
    diode-direction = "col2row";

    row-gpios
        = <&gpio0 17 (GPIO_ACTIVE_HIGH | GPIO_PULL_DOWN)>  // Row 1 (Pin 5)
        , <&gpio0 20 (GPIO_ACTIVE_HIGH | GPIO_PULL_DOWN)>  // Row 2 (Pin 6)
        , <&gpio0 22 (GPIO_ACTIVE_HIGH | GPIO_PULL_DOWN)>  // Row 3 (Pin 7)
        , <&gpio0 24 (GPIO_ACTIVE_HIGH | GPIO_PULL_DOWN)>  // Row 4 (Pin 8)
        , <&gpio1 0  (GPIO_ACTIVE_HIGH | GPIO_PULL_DOWN)>  // Row 5 (Pin 9)
        ;

    col-gpios
        = <&gpio0 31 GPIO_ACTIVE_HIGH> // Col 1 (Pin 17)
        , <&gpio0 29 GPIO_ACTIVE_HIGH> // Col 2 (Pin 18)
        , <&gpio0 2  GPIO_ACTIVE_HIGH> // Col 3 (Pin 19)
        , <&gpio1 15 GPIO_ACTIVE_HIGH> // Col 4 (Pin 20)
        , <&gpio1 13 GPIO_ACTIVE_HIGH> // Col 5 (Pin 21)
        , <&gpio1 11 GPIO_ACTIVE_HIGH> // Col 6 (Pin 22)
        ;
};